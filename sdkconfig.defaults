## sdkconfig.defaults
```kconfig
# Partition table
CONFIG_PARTITION_TABLE_CUSTOM=y
CONFIG_PARTITION_TABLE_CUSTOM_FILENAME="partitions.csv"

# Flash size
CONFIG_ESPTOOLPY_FLASHSIZE_16MB=y

# Suppress legacy I2C driver warnings (will migrate later)
CONFIG_I2C_SUPPRESS_DEPRECATE_WARN=y

# Enable SPIRAM (8MB PSRAM on ESP32-S3-Touch-LCD-1.85)
CONFIG_SPIRAM=y
CONFIG_SPIRAM_MODE_OCT=y
CONFIG_SPIRAM_SPEED_80M=y
CONFIG_SPIRAM_USE_CAPS_ALLOC=y
```
